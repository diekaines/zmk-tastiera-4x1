/*
 * Copyright (c) 2022 The ZMK Contributors
 *
 * SPDX-License-Identifier: MIT
 */

#include <behaviors.dtsi>
#include <dt-bindings/zmk/keys.h>
#include <dt-bindings/zmk/bt.h>

/ {
    keymap {
        compatible = "zmk,keymap";

        default_layer {
            bindings = <
&kp C_MUTE  &kp C_VOLUME_UP  &kp C_VOLUME_DOWN  &mo 1
            >;
        };

        bt_layer {
            bindings = <
&bt BT_SEL 0  &bt BT_SEL 1  &bt BT_CLR  &trans
            >;
        };
    };
};
